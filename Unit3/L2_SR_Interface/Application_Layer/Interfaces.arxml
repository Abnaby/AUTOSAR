AUTOSAR XML (schema 00046)
package /Interfaces/SRI_EABS
  sender receiver interface SRI_Lidar
    data SRI_u32: type=uint32
    data SRI_bool: type=boolean
