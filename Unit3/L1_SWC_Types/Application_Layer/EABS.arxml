AUTOSAR XML (schema 00046)
package /SWCs/SWCs_EABS
  sensor actuator sw component type SWC1_SA_LidarSensor
  sensor actuator sw component type SWC2_SA_SpeedSensor
  sensor actuator sw component type SWC6_SA_WarningLED
  ecu abstraction sw component type SWC3_ECABS_IO_Abstraction
  application sw component type SWC4_APP_EABS
  parameter sw component type SWC5_PARM_DistanceParameters
  complex device driver sw component type SWC7_CDD_Braking
  service sw component type SWC8_SRVS_DigM
  nv block sw component type SWC9_NV_Flash
