AUTOSAR XML (schema 00046)
package /Interfaces/I_EABS
  sender receiver interface SRI_Lidar
    data SRI_u32: type=uint32
    data SRI_bool: type=boolean
  parameter interface PRI_Lidar
    parameter data prototype PRI_CONST_DIST: type=uint8, init-value=30
  nv data interface NV_Data
    nv-datas:
      data NVI_Data: type=uint32
  client server interface CSI_EABS
    operation NV_OP_SPD
      arg NVI_Speed: type=uint32, direction=IN
    operation NV_OP_DIG
      arg NVI_DigData: type=uint32, direction=IN
