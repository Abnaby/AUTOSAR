AUTOSAR XML (schema 00046)
package /INTERFACES
  sender receiver interface IF_SR_LidarData
    data VDP_LidarSensor: type=uint32
